/dts-v1/;
/plugin/;

&pio {
	camera_pins_cam0_rst_0: cam0@0 {
		pins_cmd_dat {
			pinmux = <0x1200>;
			slew-rate = <0x01>;
			output-low;
		};
	};

	camera_pins_cam0_rst_1: cam0@1 {
		pins_cmd_dat {
			pinmux = <0x1200>;
			slew-rate = <0x01>;
			output-high;
		};
	};

	camera_pins_cam1_rst_0: cam1@0 {
		pins_cmd_dat {
			pinmux = <0x1000>;
			slew-rate = <0x01>;
			output-low;
		};
	};

	camera_pins_cam1_rst_1: cam1@1 {
		pins_cmd_dat {
			pinmux = <0x1000>;
			slew-rate = <0x01>;
			output-high;
		};
	};

	camera_pins_cam1_pdn_0: cam1pdn@0 {
		pins_cmd_dat {
			pinmux = <0x1100>;
			slew-rate = <0x01>;
			output-low;
		};
	};

	camera_pins_cam1_pdn_1: cam1pdn@1 {
		pins_cmd_dat {
			pinmux = <0x1100>;
			slew-rate = <0x01>;
			output-high;
		};
	};

	camera_pins_cam2_rst_0: cam2@0 {
		pins_cmd_dat {
			pinmux = <0x1600>;
			slew-rate = <0x01>;
			output-low;
		};
	};

	camera_pins_cam2_rst_1: cam2@1 {
		pins_cmd_dat {
			pinmux = <0x1600>;
			slew-rate = <0x01>;
			output-high;
		};
	};

	camera_pins_cam3_rst_0: cam3@0 {
		pins_cmd_dat {
			pinmux = <0x1400>;
			slew-rate = <0x01>;
			output-low;
		};
	};

	camera_pins_cam3_rst_1: cam3@1 {
		pins_cmd_dat {
			pinmux = <0x1400>;
			slew-rate = <0x01>;
			output-high;
		};
	};

	camera_pins_cam0_mclk_off: camera_pins_cam0_mclk_off {
		pins_cmd_dat {
			pinmux = <0x8100>;
			drive-strength = <0x01>;
		};
	};

	camera_pins_cam0_mclk_2ma: camera_pins_cam0_mclk_2ma {
		pins_cmd_dat {
			pinmux = <0x8101>;
			drive-strength = <0x00>;
		};
	};

	camera_pins_cam0_mclk_4ma: camera_pins_cam0_mclk_4ma {
		pins_cmd_dat {
			pinmux = <0x8101>;
			drive-strength = <0x01>;
		};
	};

	camera_pins_cam0_mclk_6ma: camera_pins_cam0_mclk_6ma {
		pins_cmd_dat {
			pinmux = <0x8101>;
			drive-strength = <0x02>;
		};
	};

	camera_pins_cam0_mclk_8ma: camera_pins_cam0_mclk_8ma {
		pins_cmd_dat {
			pinmux = <0x8101>;
			drive-strength = <0x03>;
		};
	};

	camera_pins_cam1_mclk_off: camera_pins_cam1_mclk_off {
		pins_cmd_dat {
			pinmux = <0x7e00>;
			drive-strength = <0x01>;
		};
	};

	camera_pins_cam1_mclk_2ma: camera_pins_cam1_mclk_2ma {
		pins_cmd_dat {
			pinmux = <0x7e01>;
			drive-strength = <0x00>;
		};
	};

	camera_pins_cam1_mclk_4ma: camera_pins_cam1_mclk_4ma {
		pins_cmd_dat {
			pinmux = <0x7e01>;
			drive-strength = <0x01>;
		};
	};

	camera_pins_cam1_mclk_6ma: camera_pins_cam1_mclk_6ma {
		pins_cmd_dat {
			pinmux = <0x7e01>;
			drive-strength = <0x02>;
		};
	};

	camera_pins_cam1_mclk_8ma: camera_pins_cam1_mclk_8ma {
		pins_cmd_dat {
			pinmux = <0x7e01>;
			drive-strength = <0x03>;
		};
	};

	camera_pins_cam2_mclk_off: camera_pins_cam2_mclk_off {
		pins_cmd_dat {
			pinmux = <0x7f00>;
			drive-strength = <0x01>;
		};
	};

	camera_pins_cam2_mclk_2ma: camera_pins_cam2_mclk_2ma {
		pins_cmd_dat {
			pinmux = <0x7f01>;
			drive-strength = <0x00>;
		};
	};

	camera_pins_cam2_mclk_4ma: camera_pins_cam2_mclk_4ma {
		pins_cmd_dat {
			pinmux = <0x7f01>;
			drive-strength = <0x01>;
		};
	};

	camera_pins_cam2_mclk_6ma: camera_pins_cam2_mclk_6ma {
		pins_cmd_dat {
			pinmux = <0x7f01>;
			drive-strength = <0x02>;
		};
	};

	camera_pins_cam2_mclk_8ma: camera_pins_cam2_mclk_8ma {
		pins_cmd_dat {
			pinmux = <0x7f01>;
			drive-strength = <0x03>;
		};
	};

	camera_pins_cam0_vcamio_0: cam0@vcamio0 {
		pins_cmd_dat {
			pinmux = <0x3300>;
			slew-rate = <0x01>;
			output-low;
		};
	};

	camera_pins_cam0_vcamio_1: cam0@vcamio1 {
		pins_cmd_dat {
			pinmux = <0x3300>;
			slew-rate = <0x01>;
			output-high;
		};
	};

	camera_pins_cam2_vcama_0: cam2@vcama0 {
		pins_cmd_dat {
			pinmux = <0x300>;
			slew-rate = <0x01>;
			output-low;
		};
	};

	camera_pins_cam2_vcama_1: cam2@vcama1 {
		pins_cmd_dat {
			pinmux = <0x300>;
			slew-rate = <0x01>;
			output-high;
		};
	};

	camera_pins_cam3_vcama_0: cam3@vcama0 {
		pins_cmd_dat {
			pinmux = <0x300>;
			slew-rate = <0x01>;
			output-low;
		};
	};

	camera_pins_cam3_vcama_1: cam3@vcama1 {
		pins_cmd_dat {
			pinmux = <0x300>;
			slew-rate = <0x01>;
			output-high;
		};
	};

	camera_pins_ldo_vs2pmu_0: cam0@vs2pmu0 {
		pins_cmd_dat {
			pinmux = <0x9a00>;
			slew-rate = <0x01>;
			output-low;
		};
	};

	camera_pins_ldo_vs2pmu_1: cam0@vs2pmu1 {
		pins_cmd_dat {
			pinmux = <0x9a00>;
			slew-rate = <0x01>;
			output-high;
		};
	};

	camera_pins_default: camdefault {
	};
};

&kd_camera_hw1 {
	pinctrl-names = "default", "cam0_rst0", "cam0_rst1", "cam1_rst0", "cam1_rst1", "cam1_pnd0", "cam1_pnd1", "cam2_rst0", "cam2_rst1", "cam3_rst0", "cam3_rst1", "cam0_ldo_vcamio_0", "cam0_ldo_vcamio_1", "cam1_ldo_vcamio_0", "cam1_ldo_vcamio_1", "cam2_ldo_vcamio_0", "cam2_ldo_vcamio_1", "cam2_ldo_vcama_0", "cam2_ldo_vcama_1", "cam3_ldo_vcama_0", "cam3_ldo_vcama_1", "cam0_mclk_off", "cam0_mclk_2mA", "cam0_mclk_4mA", "cam0_mclk_6mA", "cam0_mclk_8mA", "cam1_mclk_off", "cam1_mclk_2mA", "cam1_mclk_4mA", "cam1_mclk_6mA", "cam1_mclk_8mA", "cam2_mclk_off", "cam2_mclk_2mA", "cam2_mclk_4mA", "cam2_mclk_6mA", "cam2_mclk_8mA", "cam3_mclk_off", "cam3_mclk_2mA", "cam3_mclk_4mA", "cam3_mclk_6mA", "cam3_mclk_8mA", "cam0_ldo_vs2pmu_0", "cam0_ldo_vs2pmu_1", "cam1_ldo_vs2pmu_0", "cam1_ldo_vs2pmu_1";
	pinctrl-0 = <&camera_pins_default>;
	pinctrl-1 = <&camera_pins_cam0_rst_0>;
	pinctrl-2 = <&camera_pins_cam0_rst_1>;
	pinctrl-3 = <&camera_pins_cam1_rst_0>;
	pinctrl-4 = <&camera_pins_cam1_rst_1>;
	pinctrl-5 = <&camera_pins_cam1_pdn_0>;
	pinctrl-6 = <&camera_pins_cam1_pdn_1>;
	pinctrl-7 = <&camera_pins_cam2_rst_0>;
	pinctrl-8 = <&camera_pins_cam2_rst_1>;
	pinctrl-9 = <&camera_pins_cam3_rst_0>;
	pinctrl-10 = <&camera_pins_cam3_rst_1>;
	pinctrl-11 = <&camera_pins_cam0_vcamio_0>;
	pinctrl-12 = <&camera_pins_cam0_vcamio_1>;
	pinctrl-13 = <&camera_pins_cam0_vcamio_0>;
	pinctrl-14 = <&camera_pins_cam0_vcamio_1>;
	pinctrl-15 = <&camera_pins_cam0_vcamio_0>;
	pinctrl-16 = <&camera_pins_cam0_vcamio_1>;
	pinctrl-17 = <&camera_pins_cam2_vcama_0>;
	pinctrl-18 = <&camera_pins_cam2_vcama_1>;
	pinctrl-19 = <&camera_pins_cam3_vcama_0>;
	pinctrl-20 = <&camera_pins_cam3_vcama_1>;
	pinctrl-21 = <&camera_pins_cam0_mclk_off>;
	pinctrl-22 = <&camera_pins_cam0_mclk_2ma>;
	pinctrl-23 = <&camera_pins_cam0_mclk_4ma>;
	pinctrl-24 = <&camera_pins_cam0_mclk_6ma>;
	pinctrl-25 = <&camera_pins_cam0_mclk_8ma>;
	pinctrl-26 = <&camera_pins_cam1_mclk_off>;
	pinctrl-27 = <&camera_pins_cam1_mclk_2ma>;
	pinctrl-28 = <&camera_pins_cam1_mclk_4ma>;
	pinctrl-29 = <&camera_pins_cam1_mclk_6ma>;
	pinctrl-30 = <&camera_pins_cam1_mclk_8ma>;
	pinctrl-31 = <&camera_pins_cam2_mclk_off>;
	pinctrl-32 = <&camera_pins_cam2_mclk_2ma>;
	pinctrl-33 = <&camera_pins_cam2_mclk_4ma>;
	pinctrl-34 = <&camera_pins_cam2_mclk_6ma>;
	pinctrl-35 = <&camera_pins_cam2_mclk_8ma>;
	pinctrl-36 = <&camera_pins_cam2_mclk_off>;
	pinctrl-37 = <&camera_pins_cam2_mclk_2ma>;
	pinctrl-38 = <&camera_pins_cam2_mclk_4ma>;
	pinctrl-39 = <&camera_pins_cam2_mclk_6ma>;
	pinctrl-40 = <&camera_pins_cam2_mclk_8ma>;
	pinctrl-41 = <&camera_pins_ldo_vs2pmu_0>;
	pinctrl-42 = <&camera_pins_ldo_vs2pmu_1>;
	pinctrl-43 = <&camera_pins_ldo_vs2pmu_0>;
	pinctrl-44 = <&camera_pins_ldo_vs2pmu_1>;
	cam0_pin_mclk = "mclk";
	cam0_pin_rst = "gpio";
	cam0_pin_vs2pmu = "gpio";
	cam0_pin_vcama = "regulator";
	cam0_pin_vcamio = "gpio";
	cam0_pin_vcamd = "regulator";
	cam1_pin_mclk = "mclk";
	cam1_pin_rst = "gpio";
	cam1_pin_pdn = "gpio";
	cam1_pin_vs2pmu = "gpio";
	cam1_pin_exta2 = "regulator";
	cam1_pin_vcamio = "gpio";
	cam1_pin_extd2 = "regulator";
	cam2_pin_mclk = "mclk";
	cam2_pin_rst = "gpio";
	cam2_pin_vcama = "gpio";
	cam2_pin_vcamio = "gpio";
	cam3_pin_mclk = "mclk";
	cam3_pin_rst = "gpio";
	cam3_pin_vcama = "gpio";
	cam0_enable_sensor = "s5khm6sx_mipi_raw";
	cam1_enable_sensor = "gc32e1_mipi_raw";
	cam2_enable_sensor = "gc02m1macro_mipi_raw";
	cam3_enable_sensor = "fake_serial_yuv";
	camera_input_gpio = <&pio 0x35 0x00>;
	status = "okay";
};

&i2c2 {
	status = "okay";
	clock-frequency = <0xf4240>;
	#address-cells = <0x01>;
	#size-cells = <0x00>;

	mtk_camera_eeprom0: camera_eeprom0@50 {
		compatible = "mediatek,camera_eeprom";
		reg = <0x50>;
		status = "okay";
	};

	camera_main_mtk: camera_main@1a {
		compatible = "mediatek,camera_main";
		#thermal-sensor-cells = <0x00>;
		reg = <0x2a>;
		status = "okay";
	};

	camera_main_af_mtk: camera_main_af@0c {
		compatible = "mediatek,camera_main_af";
		reg = <0x0c>;
		status = "okay";
	};
};

&i2c8 {
	status = "okay";
	clock-frequency = <0x61a80>;
	#address-cells = <0x01>;
	#size-cells = <0x00>;

	mtk_camera_eeprom1: camera_eeprom1@51 {
		compatible = "mediatek,camera_eeprom";
		reg = <0x51>;
		status = "okay";
	};

	camera_sub_mtk: camera_sub@10 {
		compatible = "mediatek,camera_sub";
		#thermal-sensor-cells = <0x00>;
		reg = <0x10>;
		status = "okay";
	};
};

&i2c4 {
	status = "okay";
	clock-frequency = <0x61a80>;
	#address-cells = <0x01>;
	#size-cells = <0x00>;

	camera_main_two_mtk: camera_main_two@10 {
		compatible = "mediatek,camera_main_two";
		#thermal-sensor-cells = <0x00>;
		reg = <0x10>;
		status = "okay";
	};
};

&pio {
	ext_ldo_pins_default: extldodefault {
	};

	ext_ldo_pins_hwen_high: extldo_en_high {
		pins_cmd_dat {
			pinmux = <0x9900>;
			output-high;
		};
	};

	ext_ldo_pins_hwen_low: extldo_en_low {
		pins_cmd_dat {
			pinmux = <0x9900>;
			output-low;
		};
	};
};

&odm {
	cam_vdd_extldo: cam_vdd_extldo {
		compatible = "mediatek,cam_vdd_extldo";
		pinctrl-names = "extldodefault", "extldo_en_high", "extldo_en_low";
		pinctrl-0 = <&ext_ldo_pins_default>;
		pinctrl-1 = <&ext_ldo_pins_hwen_high>;
		pinctrl-2 = <&ext_ldo_pins_hwen_low>;
		status = "okay";
	};
};

&i2c7 {
	#address-cells = <0x01>;
	#size-cells = <0x00>;
	clock-frequency = <0x61a80>;
	mediatek,use-open-drain;

	cam_vdd_ext@28 {
		compatible = "mediatek,cam_vdd_ext";
		reg = <0x28>;
		status = "okay";
	};
};

&i2c5 {
	#address-cells = <0x01>;
	#size-cells = <0x00>;
	clock-frequency = <0x61a80>;
	mediatek,use-open-drain;

	strobe_main_mtk: strobe_main@63 {
		compatible = "mediatek,strobe_main";
		reg = <0x63>;
		status = "okay";
	};
};

&odm {
	flashlights_ocp81375: flashlights_ocp81375 {
		compatible = "mediatek,flashlights_ocp81375";
		status = "okay";
		ocp81375_regulator-supply = <&flashlight_gpio157>;
	};

	flashlight_gpio157: flashlight_gpio157 {
		compatible = "regulator-fixed";
		regulator-name = "flashlight_gpio157";
		regulator-min-microvolt = <0x1b7740>;
		regulator-max-microvolt = <0x1b7740>;
		gpio = <&pio 0x9d 0x00>;
		enable-active-high;
	};
};

&camera_af_hw_node {
	camaf_m1_pmic-supply = <&mt6358_vio28_reg>;
	status = "okay";
};

&thermal_zones {
	camera_main: camera_main {
		polling-delay = <0x3e8>;
		polling-delay-passive = <0x00>;
		thermal-sensors = <&camera_main_mtk>;
	};

	camera_sub: camera_sub {
		polling-delay = <0x3e8>;
		polling-delay-passive = <0x00>;
		thermal-sensors = <&camera_sub_mtk>;
	};

	camera_main_two: camera_main_two {
		polling-delay = <0x3e8>;
		polling-delay-passive = <0x00>;
		thermal-sensors = <&camera_main_two_mtk>;
	};
};

&chosen {
};

&i2c5 {
	i2c_lcd_bias@3e {
		compatible = "mediatek,i2c_lcd_bias";
		reg = <0x3e>;
		status = "okay";
	};
};

&mtk_leds {
	compatible = "mediatek,pwm-leds";

	backlight {
		led_mode = <0x05>;
		pwm_config = <0x03 0x00 0x00 0x00 0x00>;
		pwms = <&disp_pwm 0x00 0x99d9>;
		pwm-names = "lcd-backlight";
		max-brightness = <0xfff>;
		max-hw-brightness = <0xfff>;
	};
};

&pio {
	mtkfb_pins_lcm_reset0: lcm_rst_out0_gpio {
		pins_cmd_dat {
			pinmux = <0x5500>;
			slew-rate = <0x01>;
			output-low;
		};
	};

	mtkfb_pins_lcm_reset1: lcm_rst_out1_gpio {
		pins_cmd_dat {
			pinmux = <0x5500>;
			slew-rate = <0x01>;
			output-high;
		};
	};

	mtkfb_pins_lcd_bias_enp0: lcd_bias_enp0_gpio {
		pins_cmd_dat {
			pinmux = <0x3700>;
			slew-rate = <0x01>;
			output-low;
		};
	};

	mtkfb_pins_lcd_bias_enp1: lcd_bias_enp1_gpio {
		pins_cmd_dat {
			pinmux = <0x3700>;
			slew-rate = <0x01>;
			output-high;
		};
	};

	mtkfb_pins_lcd_bias_enn0: lcd_bias_enn0_gpio {
		pins_cmd_dat {
			pinmux = <0x3600>;
			slew-rate = <0x01>;
			output-low;
		};
	};

	mtkfb_pins_lcd_bias_enn1: lcd_bias_enn1_gpio {
		pins_cmd_dat {
			pinmux = <0x3600>;
			slew-rate = <0x01>;
			output-high;
		};
	};

	mtkfb_pins_lcm_dsi_te: lcm_dsi_te {
		pins_cmd_dat {
			pinmux = <0x5301>;
		};
	};

	mtkfb_pins_default: dispdefault {
	};
};

&mtkfb {
	pinctrl-names = "dispdefault", "lcm_rst_out0_gpio", "lcm_rst_out1_gpio", "lcd_bias_enp0_gpio", "lcd_bias_enp1_gpio", "lcd_bias_enn0_gpio", "lcd_bias_enn1_gpio";
	pinctrl-0 = <&mtkfb_pins_default>;
	pinctrl-1 = <&mtkfb_pins_lcm_reset0>;
	pinctrl-2 = <&mtkfb_pins_lcm_reset1>;
	pinctrl-3 = <&mtkfb_pins_lcd_bias_enp0>;
	pinctrl-4 = <&mtkfb_pins_lcd_bias_enp1>;
	pinctrl-5 = <&mtkfb_pins_lcd_bias_enn0>;
	pinctrl-6 = <&mtkfb_pins_lcd_bias_enn1>;
	status = "okay";
};

&dispsys_config {
	pinctrl-names = "dispdefault", "lcm_rst_out0_gpio", "lcm_rst_out1_gpio", "lcd_bias_enp0_gpio", "lcd_bias_enp1_gpio", "lcd_bias_enn0_gpio", "lcd_bias_enn1_gpio";
	pinctrl-0 = <&mtkfb_pins_default>;
	pinctrl-1 = <&mtkfb_pins_lcm_reset0>;
	pinctrl-2 = <&mtkfb_pins_lcm_reset1>;
	pinctrl-3 = <&mtkfb_pins_lcd_bias_enp0>;
	pinctrl-4 = <&mtkfb_pins_lcd_bias_enp1>;
	pinctrl-5 = <&mtkfb_pins_lcd_bias_enn0>;
	pinctrl-6 = <&mtkfb_pins_lcd_bias_enn1>;
	helper-value = <0x00 0x01 0x01 0x01 0x01 0x00 0x01 0x00 0x00 0x00 0x00 0x00 0x01 0x00 0x01 0x01 0x01 0x01 0x00 0x01 0x01 0x01 0x00 0x01 0x00 0x01 0x00 0x00 0x00 0x00 0x01 0x00 0x00 0x00 0x00 0x00 0x00 0x00 0x00 0x01 0x01 0x00 0x01 0x00 0x00 0x00 0x00>;
	status = "okay";
};

&dsi0 {
	status = "okay";
	#address-cells = <0x01>;
	#size-cells = <0x00>;

	panel1@0 {
		compatible = "ili7807s,fhdp,dsi,vdo,tm,tm,120hz,x6837";
		reg = <0x00>;
		reset-gpios = <&pio 0x55 0x00>;
		bias-gpios = <&pio 0x37 0x00 &pio 0x36 0x00>;
		pinctrl-names = "default";

		port {
			panel_in1: endpoint {
				remote-endpoint = <&dsi_out>;
			};
		};
	};

	panel2@0 {
		compatible = "ft8725,fhdp,dsi,vdo,txd,inx,120hz,x6837";
		reg = <0x01>;
		reset-gpios = <&pio 0x55 0x00>;
		bias-gpios = <&pio 0x37 0x00 &pio 0x36 0x00>;
		pinctrl-names = "default";

		port {
			panel_in2: endpoint {
				remote-endpoint = <&dsi_out>;
			};
		};
	};

	panel3@0 {
		compatible = "ft8725,fhdp,dsi,vdo,lce,inx,120hz,x6837";
		reg = <0x02>;
		reset-gpios = <&pio 0x55 0x00>;
		bias-gpios = <&pio 0x37 0x00 &pio 0x36 0x00>;
		pinctrl-names = "default";

		port {
			panel_in3: endpoint {
				remote-endpoint = <&dsi_out>;
			};
		};
	};

	panel4@0 {
		compatible = "il77600a,fhdp,dsi,vdo,tm,tm,120hz,x6837";
		reg = <0x03>;
		reset-gpios = <&pio 0x55 0x00>;
		bias-gpios = <&pio 0x37 0x00 &pio 0x36 0x00>;
		pinctrl-names = "default";

		port {
			panel_in4: endpoint {
				remote-endpoint = <&dsi_out>;
			};
		};
	};

	ports {
		port {
			dsi_out: endpoint {
				remote-endpoint = <&panel_in1>;
			};
		};
	};
};

&odm {
	led6: led@6 {
		compatible = "mediatek,lcd-backlight";
		led_mode = <0x05>;
		data = <0x01>;
		pwm_config = <0x03 0x00 0x00 0x00 0x00>;
	};

	fingerprint: fingerprint {
		compatible = "tran_fp";
		interrupt-parent = <&pio>;
		interrupts = <0x0d 0x01 0x0d 0x00>;
		debounce = <0x0d 0x00>;
		pinctrl-names = "tran_fp_default", "tran_fp_pin_irq", "tran_fp_irq_pull_down", "tran_fp_reset_high", "tran_fp_reset_low";
		pinctrl-0 = <&fingerprint_default>;
		pinctrl-1 = <&fingerprint_eint>;
		pinctrl-2 = <&fingerprint_eint_pull_down>;
		pinctrl-3 = <&fingerprint_rst_one>;
		pinctrl-4 = <&fingerprint_rst_zero>;
		status = "okay";
	};
};

&spi1 {
	fingerprint@0 {
		compatible = "tran_fp";
		reg = <0x00>;
		spi-max-frequency = <0x19bfcc0>;
		interrupt-parent = <&pio>;
		interrupts = <0x0d 0x01 0x0d 0x00>;
		debounce = <0x0d 0x00>;
		irq-gpio = <0x0d>;
		irq-gpio-std = <&pio 0x0d 0x00>;
		reset-gpio = <0x06>;
		reset-gpio-std = <&pio 0x06 0x00>;
		tran,gpio_pwr = <0x41>;
		tran,gpio_pwr-std = <&pio 0x41 0x00>;
		pinctrl-names = "tran_fp_default", "tran_fp_pin_irq", "tran_fp_irq_pull_down", "tran_fp_reset_high", "tran_fp_reset_low", "tran_fp_spi_default";
		chipone;
		goodix;
		pinctrl-0 = <&fingerprint_default>;
		pinctrl-1 = <&fingerprint_eint>;
		pinctrl-2 = <&fingerprint_eint_pull_down>;
		pinctrl-3 = <&fingerprint_rst_one>;
		pinctrl-4 = <&fingerprint_rst_zero>;
		pinctrl-5 = <&fingerprint_spi_default>;
		status = "okay";
	};
};

&pio {
	fingerprint_default: fingerprint_default {
	};

	fingerprint_eint: gpio13_eint {
		pins_cmd_dat {
			pinmux = <0xd00>;
			slew-rate = <0x00>;
			bias-disable;
		};
	};

	fingerprint_eint_pull_down: gpio13_eint_pull_down {
		pins_cmd_dat {
			pinmux = <0xd00>;
			slew-rate = <0x00>;
			bias-pull-down = <0x00>;
			output-low;
		};
	};

	fingerprint_rst_one: rst_out_one {
		pins_cmd_dat {
			pinmux = <0x600>;
			slew-rate = <0x01>;
			bias-disable;
			output-high;
		};
	};

	fingerprint_rst_zero: rst_out_zero {
		pins_cmd_dat {
			pinmux = <0x600>;
			slew-rate = <0x01>;
			bias-disable;
			output-low;
		};
	};

	fingerprint_spi_default: spimode_default {
		pins_cmd_dat {
			pinmux = <0x2301>;
		};
	};
};

&pio {
	gps_pins_default: gps_default {
	};

	gps_l1_lna_pins_ol: gps_l1_lna@0 {
		pins_cmd_dat {
			pinmux = <0x1900>;
			output-low;
		};
	};

	gps_l1_lna_pins_dsp_ctrl: gps_l1_lna@1 {
		pins_cmd_dat {
			pinmux = <0x1902>;
		};
	};

	gps_l1_lna_pins_oh: gps_l1_lna@2 {
		pins_cmd_dat {
			pinmux = <0x1900>;
			output-high;
		};
	};
};

&gps {
	pinctrl-names = "default", "gps_l1_lna_disable", "gps_l1_lna_dsp_ctrl", "gps_l1_lna_enable";
	pinctrl-0 = <&gps_pins_default>;
	pinctrl-1 = <&gps_l1_lna_pins_ol>;
	pinctrl-2 = <&gps_l1_lna_pins_dsp_ctrl>;
	pinctrl-3 = <&gps_l1_lna_pins_oh>;
	status = "okay";
};

&pio {
	tran_audio: tran_audio {
		compatible = "tran_audio,audio";
		CONFIG_SND_SOC_AW87XXX = <0x01>;
	};
};

&i2c7 {
	aw87xxx_pa@58 {
		compatible = "awinic,aw87xxx_pa";
		reg = <0x58>;
		dev_index = <0x01>;
		status = "okay";
	};

	aw87xxx_pa@59 {
		compatible = "awinic,aw87xxx_pa";
		reg = <0x59>;
		dev_index = <0x00>;
		status = "okay";
	};
};

&i2c3 {
	clock-frequency = <0x61a80>;
	status = "okay";

	nfc_nxp@28 {
		compatible = "nxp,pn544";
		reg = <0x28>;
		nxp,pn544-irq = <&pio 0x01 0x00>;
		nxp,pn544-ven = <&pio 0x2c 0x00>;
		nxp,pn544-fw-dwnld = <&pio 0x0a 0x00>;
	};

	irq_nfc: irq_nfc {
		compatible = "mediatek,irq_nfc-eint";
		interrupt-parent = <&pio>;
		interrupts = <0x01 0x04>;
		status = "okay";
	};
};

&touch {
	supplier-num = <0x04>;
	supplier-vendor-0 = "TM";
	supplier-0 = "ili7807s_fhdp_dsi_vdo_tm_tm_120hz_x6837, ilitek, ili7807s";
	supplier-resolution-0 = <0x08>;
	supplier-vendor-1 = "TXD";
	supplier-1 = "ft8725_fhdp_dsi_vdo_txd_inx_120hz_x6837, focaltech, ft8725";
	supplier-resolution-1 = <0x08>;
	supplier-vendor-2 = "LCE";
	supplier-2 = "ft8725_fhdp_dsi_vdo_lce_inx_120hz_x6837, focaltech, ft8725";
	supplier-resolution-2 = <0x08>;
	supplier-vendor-3 = "TM";
	supplier-3 = "ili77600a_fhdp_dsi_vdo_tm_tm_120hz_x6837, ilitek, ili77600a";
	supplier-resolution-3 = <0x08>;
};

&spi0 {
	tran_touch: touch@0 {
		compatible = "tchip,ilitek", "focaltech,fts";
		reg = <0x00>;
		spi-max-frequency = <0x7a1200>;
		status = "okay";
		touch,irq-gpio = <&pio 0x09 0x00>;
		touch,reset-gpio = <&pio 0x98 0x00>;
		focaltech,irq-gpio = <&pio 0x09 0x00>;
		focaltech,reset-gpio = <&pio 0x98 0x00>;
		focaltech,max-touch-number = <0x05>;
		focaltech,display-coords = <0x00 0x00 0x21bf 0x4cdf>;
	};
};

&pio {
	ctp_pins_default: eint0default {
	};

	ctp_pins_eint_as_int: ctp_eint@0 {
		pins_cmd_dat {
			pinmux = <0x900>;
			slew-rate = <0x00>;
		};
	};

	ctp_pins_eint_output0: eintoutput0 {
		pins_cmd_dat {
			pinmux = <0x900>;
			slew-rate = <0x01>;
			output-low;
		};
	};

	ctp_pins_eint_output1: eintoutput1 {
		pins_cmd_dat {
			pinmux = <0x900>;
			slew-rate = <0x01>;
			output-high;
		};
	};

	ctp_pins_rst_output0: rstoutput0 {
		pins_cmd_dat {
			pinmux = <0x9800>;
			slew-rate = <0x01>;
			output-low;
		};
	};

	ctp_pins_rst_output1: rstoutput1 {
		pins_cmd_dat {
			pinmux = <0x9800>;
			slew-rate = <0x01>;
			output-high;
		};
	};
};

&pdc {
	pd_vbus_upper_bound = <0x989680>;
};

&pio {
	fmradio: fmradio {
		compatible = "mediatek,fmradio";
		#address-cells = <0x02>;
		#size-cells = <0x02>;
		fm_lna_gpio = <&pio 0x30 0x00>;
		status = "okay";
	};
};

&i2c6 {
	#address-cells = <0x01>;
	#size-cells = <0x00>;
	clock-frequency = <0x61a80>;
	mediatek,use-open-drain;

	rt1711_typec: usb_type_c@4e {
		compatible = "mediatek,usb_type_c";
		reg = <0x4e>;
		status = "okay";
		rt-tcpc,name = "type_c_port0";
		rt-tcpc,role_def = <0x05>;
		rt-tcpc,rp_level = <0x02>;
		rt-tcpc,vconn_supply = <0x01>;
		rt-tcpc,notifier_supply_num = <0x03>;
		rt1711pd,intr_gpio = <&pio 0x45 0x00>;
		rt1711pd,intr_gpio_num = <0x45>;

		pd-data {
			pd,vid = <0x29cf>;
			pd,pid = <0x1711>;
			pd,source-cap-ext = <0x171129cf 0x00 0x00 0x00 0x00 0x2000000>;
			pd,mfrs = "RichtekTCPC";
			pd,charging_policy = <0x31>;
			pd,source-pdo-size = <0x02>;
			pd,source-pdo-data = <0x19032 0x190c8>;
			pd,sink-pdo-size = <0x01>;
			pd,sink-pdo-data = <0x190c8>;
			pd,id-vdo-size = <0x06>;
			pd,id-vdo-data = <0xd14029cf 0x00 0x17110000 0x41800000 0x00 0x21800000>;
			bat,nr = <0x01>;
			pd,country_nr = <0x00>;

			bat-info0 {
				bat,vid = <0x29cf>;
				bat,pid = <0x1711>;
				bat,mfrs = "bat1";
				bat,design_cap = <0xbb8>;
			};
		};

		dpm_caps {
			local_dr_power;
			local_dr_data;
			local_usb_comm;
			local_no_suspend;
			local_vconn_supply;
			attemp_enter_dp_mode;
			attemp_discover_cable;
			attemp_discover_id;
			pr_check = <0x00>;
			dr_check = <0x00>;
		};

		displayport {
			1st_connection = "dfp_d";
			2nd_connection = "dfp_d";
			signal,dp_v13;
			typec,receptacle;

			ufp_d {
			};

			dfp_d {
				pin_assignment,mode_c;
				pin_assignment,mode_d;
				pin_assignment,mode_e;
			};
		};
	};
};

&i2c6 {
	#address-cells = <0x01>;
	#size-cells = <0x00>;

	switch_chg: sc-swchg@6b {
		compatible = "southchip,sc8950";
		reg = <0x6b>;
		sc8950,intr_gpio = <&pio 0x04 0x00>;
		status = "okay";
		phys = <&u2port0 0x03>;
		phy-names = "usb2-phy";
		usb = <&usb>;
		chg_name = "primary_chg";
		chg_alias_name = "sc8950_chg";

		otg_vbus: usb-otg-vbus {
			regulator-compatible = "usb-otg-vbus";
			regulator-name = "usb-otg-vbus";
			regulator-min-microvolt = <0x4a0150>;
			regulator-max-microvolt = <0x5265c0>;
			regulator-min-microamp = <0x7a120>;
			regulator-max-microamp = <0x256250>;
		};
	};
};

&mtk_ctd {
	bc12 = <&switch_chg>;
	bc12_sel = <0x00>;
	status = "okay";
};

&charger {
	charger = <&switch_chg>;
};

&mtk_gauge {
	charger = <&switch_chg>;
};

&i2c9 {
	#address-cells = <0x01>;
	#size-cells = <0x00>;

	hl7138_master@54 {
		compatible = "richtek,hl7139";
		status = "okay";
		reg = <0x54>;
		rm_name = "hl7139";
		rm_slave_addr = [54];
		hl7138,intr-gpios = <&pio 0x00 0x00>;

		standalone {
			chg_name = "primary_dvchg";
			vbatovp = <0x456d70>;
			ibatocp = <0x6c5660>;
			vbusovp = <0xa7d8c0>;
			ibusocp = <0x40d990>;
			vacovp = <0xa7d8c0>;
			wdt = <0x1c9c380>;
			ibat_rsense = <0x01>;
			gpp_conf = <0x00>;
			protocol_i_masked = <0x01>;
			vbat_reg_dis;
			ibat_reg_dis;
			iin_reg_dis;
			ibatocp_dis;
		};

		master {
			chg_name = "primary_dvchg";
			vbatovp = <0x44aa20>;
			ibatocp = <0x5d1420>;
			vbusovp = <0xa7d8c0>;
			ibusocp = <0x40d990>;
			vacovp = <0xa7d8c0>;
			wdt = <0x1c9c380>;
			ibat_rsense = <0x01>;
			state_chg_i_masked = <0x00>;
			reg_i_masked = <0x00>;
			ts_temp_i_masked = <0x00>;
			v_ok_i_masked = <0x00>;
			cur_i_masked = <0x00>;
			short_i_masked = <0x00>;
			wdog_i_masked = <0x00>;
			protocol_i_masked = <0x00>;
			vbat_reg_dis;
			ibat_reg_dis;
			iin_reg_dis;
			ibatocp_dis;
		};
	};
};

&pe5 {
	compatible = "mediatek,charger,pe5";
	gauge = <&mtk_gauge>;
	charger = <&switch_chg>;
	polling_interval = <0x2710>;
	ta_cv_ss_repeat_tmin = <0x19>;
	vbat_cv = <0x1180>;
	start_soc_min = <0x00>;
	start_soc_max = <0x5f>;
	start_vbat_max = <0x1130>;
	idvchg_term = <0x1f4>;
	idvchg_step = <0x32>;
	ita_stable_cnt = <0x14>;
	ita_level = <0xce4 0x8ca 0x7d0 0x5dc>;
	rcable_level = <0xfa 0x15e 0x1c2 0x226>;
	ita_level_dual = <0x11f8 0xea6 0xd48 0xbb8>;
	rcable_level_dual = <0xfa 0x15e 0x1c2 0x226>;
	idvchg_ss_init = <0x4b0>;
	idvchg_ss_step = <0xfa>;
	idvchg_ss_step1 = <0x64>;
	idvchg_ss_step2 = <0x32>;
	idvchg_ss_step1_vbat = <0xfa0>;
	idvchg_ss_step2_vbat = <0x1068>;
	ta_blanking = <0x190>;
	swchg_aicr = <0x00>;
	swchg_ichg = <0x4b0>;
	swchg_aicr_ss_init = <0x190>;
	swchg_aicr_ss_step = <0xc8>;
	swchg_off_vbat = <0x109a>;
	force_ta_cv_vbat = <0x109a>;
	project_power = <0x21>;
	chg_time_max = <0x4650>;
	tta_level_def = <0x00 0x00 0x00 0x00 0x19 0x5a 0x5f 0x64 0x69>;
	tta_curlmt = <0x00 0x00 0x00 0x00 0x00 0x96 0x12c 0x1c2 0xffffffff>;
	tta_recovery_area = <0x03>;
	tbat_level_def = <0x0f 0x0f 0x0f 0x14 0x19 0x27 0x28 0x2a 0x2d>;
	tbat_curlmt = <0xffffffff 0xffffffff 0x00 0x00 0x00 0x1f4 0x320 0x514 0xffffffff>;
	tbat_recovery_area = <0x03>;
	tdvchg_level_def = <0x00 0x00 0x00 0x05 0x19 0x46 0x4b 0x50 0x55>;
	tdvchg_curlmt = <0xffffffff 0xffffffff 0xffffffff 0x12c 0x00 0x96 0x12c 0x1c2 0xffffffff>;
	tdvchg_recovery_area = <0x03>;
	tswchg_level_def = <0x00 0x00 0x00 0x05 0x19 0x41 0x46 0x4b 0x50>;
	tswchg_curlmt = <0xffffffff 0xffffffff 0xffffffff 0xc8 0x00 0xc8 0x12c 0x190 0xffffffff>;
	tswchg_recovery_area = <0x03>;
	tpcb_level_def = <0x00 0x00 0x00 0x00 0x19 0x29 0x2a 0x2c 0x5a>;
	tpcb_curlmt = <0x00 0x00 0x00 0x00 0x00 0x384 0x640 0x7d0 0xffffffff>;
	tpcb_recovery_area = <0x03>;
	ifod_threshold = <0xc8>;
	rsw_min = <0x14>;
	ircmp_rbat = <0x05>;
	ircmp_vclamp = <0x00>;
	vta_cap_min = <0x1a90>;
	vta_cap_max = <0x2904>;
	ita_cap_min = <0x3e8>;
	support_ta = "rfc_adapter", "pd_adapter";
	allow_not_check_ta_status;
	rechg_ab_h = <0x29 0xffffffff 0xffffffff 0xffffffff 0xffffffff 0xffffffff>;
	rechg_ab_l = <0x10 0xffffffff 0xffffffff 0xffffffff 0xffffffff 0xffffffff>;
	dv2_ab_dev = <0x00 0x00 0x00 0x00 0x00 0x00>;
	dv2_ffc_vbat = <0x1068 0x1180 0x1180 0x1180 0x1180>;
	dv2_ffc_ibat = <0xce4 0x8ca 0x8ca 0x8ca 0x8ca>;
	dv2_ffc_gera_vbat_l = <0x1068 0x116c 0x116c 0x116c 0x116c>;
	dv2_ffc_gera_ibat_l = <0xce4 0x8ca 0x8ca 0x8ca 0x8ca>;
	dv2_ffc_gera_vbat_m = <0x1068 0x1158 0x1158 0x1158 0x1158>;
	dv2_ffc_gera_ibat_m = <0xce4 0x8ca 0x8ca 0x8ca 0x8ca>;
	dv2_ffc_gera_vbat_h = <0x1068 0x1158 0x1158 0x1158 0x1158>;
	dv2_ffc_gera_ibat_h = <0xce4 0x8ca 0x8ca 0x8ca 0x8ca>;
	dv2_ffc_temp_level_def = <0x14 0x23>;
	allow_mint_ffc;
	dv2_ffc_vbat_low = <0x1068 0x1068 0x1068 0x1068>;
	dv2_ffc_ibat_low = <0xce4 0xce4 0xce4 0xce4>;
	dv2_ffc_vbat_mid = <0x1180 0x1180 0x1180 0x1180>;
	dv2_ffc_ibat_mid = <0x8ca 0x8ca 0x8ca 0x8ca>;
	dv2_ffc_vbat_high = <0x1180 0x1180 0x1180 0x1180>;
	dv2_ffc_ibat_high = <0x8ca 0x8ca 0x8ca 0x8ca>;
	dv2_ffc_vbat_high_ext1 = <0x1180 0x1180 0x1180 0x1180>;
	dv2_ffc_ibat_high_ext1 = <0x8ca 0x8ca 0x8ca 0x8ca>;
	dv2_ffc_vbat_high_ext2 = <0x1180 0x1180 0x1180 0x1180>;
	dv2_ffc_ibat_high_ext2 = <0x8ca 0x8ca 0x8ca 0x8ca>;
	dv2_ffc_vbat_low_lt = <0x1068 0x1068 0x1068 0x1068>;
	dv2_ffc_ibat_low_lt = <0xce4 0xce4 0xce4 0xce4>;
	dv2_ffc_vbat_mid_lt = <0x1180 0x1180 0x1180 0x1180>;
	dv2_ffc_ibat_mid_lt = <0x8ca 0x8ca 0x8ca 0x8ca>;
	dv2_ffc_vbat_high_lt = <0x1180 0x1180 0x1180 0x1180>;
	dv2_ffc_ibat_high_lt = <0x8ca 0x8ca 0x8ca 0x8ca>;
	dv2_ffc_vbat_high_ext1_lt = <0x1180 0x1180 0x1180 0x1180>;
	dv2_ffc_ibat_high_ext1_lt = <0x8ca 0x8ca 0x8ca 0x8ca>;
	dv2_ffc_vbat_high_ext2_lt = <0x1180 0x1180 0x1180 0x1180>;
	dv2_ffc_ibat_high_ext2_lt = <0x8ca 0x8ca 0x8ca 0x8ca>;
	dv2_ffc_vbat_low_mint = <0x1068 0x1068 0x1068 0x1068>;
	dv2_ffc_ibat_low_mint = <0x992 0x992 0x992 0x992>;
	dv2_ffc_vbat_mid_mint = <0x1162 0x1162 0x1162 0x1162>;
	dv2_ffc_ibat_mid_mint = <0x6b8 0x6b8 0x6b8 0x6b8>;
	dv2_ffc_vbat_high_mint = <0x1162 0x1162 0x1162 0x1162>;
	dv2_ffc_ibat_high_mint = <0x6b8 0x6b8 0x6b8 0x6b8>;
	dv2_ffc_vbat_high_ext1_mint = <0x1162 0x1162 0x1162 0x1162>;
	dv2_ffc_ibat_high_ext1_mint = <0x6b8 0x6b8 0x6b8 0x6b8>;
	dv2_ffc_vbat_high_ext2_mint = <0x1162 0x1162 0x1162 0x1162>;
	dv2_ffc_ibat_high_ext2_mint = <0x6b8 0x6b8 0x6b8 0x6b8>;
	idvchg_pps_term = <0x4b0>;
	lcd_on_ita = <0x7d0>;
};

&odm {
	usb_switch: usb_switch {
		compatible = "tran,usb_switch";
		switch_built_in_ic;
		status = "okay";
	};

	pca_rfc_ta {
		compatible = "richtek,pca_rfc_ta";
		status = "okay";
		adapter_name = "rfc_adapter";
		vta_step = <0x28>;
		ita_step = <0x1e>;
		ita_gap_per_vstep = <0x14>;
		ita_gap_cv_mode = <0x64>;
		pwr_lmt;
		support_meas_cap;
		support_status;
	};
};

&i2c9 {
	clock-frequency = <0x186a0>;

	rfc_ta@1b {
		compatible = "richtek,rfc_ta";
		reg = <0x1b>;
		status = "okay";
		pinctrl-names = "i2c_sclk_mode", "i2c_sda_mode";
		pinctrl-0 = <&gpio_i2c_sclk_mode>;
		pinctrl-1 = <&gpio_i2c_sda_mode>;
	};
};

&pio {
	gpio_i2c_sclk_mode: i2c_sclk_mode {
		pins_cmd_dat {
			pinmux = <0x9401>;
			drive-strength = <0x03>;
			mediatek,drive-strength-adv = <0x00>;
			bias-pull-up = <0xcd>;
		};
	};

	gpio_i2c_sda_mode: i2c_sda_mode {
		pins_cmd_dat {
			pinmux = <0x9501>;
			drive-strength = <0x03>;
			mediatek,drive-strength-adv = <0x00>;
			bias-pull-up = <0xcd>;
		};
	};
};

&odm {
	tran_battery: tran_battery {
		compatible = "tran,chg_fun";
		status = "okay";
		bootmode = <&chosen>;
		enable_pcb_tml;
		pcb_temp_step_one = <0x9470>;
		pcb_cur_step_one = <0x190>;
		pcb_temp_step_two = <0xa410>;
		pcb_cur_step_two = <0x190>;
		pcb_min_chg_cur = <0xf4240>;
		jeita_below_t0_chg_cur = <0x00>;
		jeita_t0_to_t1_chg_cur = <0xf4240>;
		jeita_t2_to_t3_chg_cur = <0x1e8480>;
		jeita_t3_to_t4_chg_cur = <0x1e8480>;
		jeita_above_t4_chg_cur = <0x00>;
		jeita_below_t0_input_cur = <0x16e360>;
		jeita_t0_to_t1_input_cur = <0x16e360>;
		jeita_t2_to_t3_input_cur = <0x200b20>;
		jeita_t3_to_t4_input_cur = <0x200b20>;
		jeita_above_t4_input_cur = <0xf4240>;
	};

	tran_battery_aging: tran_battery_aging {
		compatible = "tran,chg_aging";
		status = "okay";
		battery_aging_module0 = <0x00>;
		battery_aging_module1 = <0x00>;
		battery_aging_module2 = <0x00>;
		battery_aging_module3 = <0x00>;
	};

	tran_auto_test: tran_auto_test {
		compatible = "tran,auto_test";
		status = "okay";
	};

	tran_otg: tran_otg {
		compatible = "tran,otg_fun";
		pinctrl-names = "otg_gpio_init", "otg_gpio_low", "otg_gpio_high", "meta_gpio_init", "meta_gpio_low", "meta_gpio_high";
		pinctrl-0 = <&gpio_otg>;
		pinctrl-1 = <&gpio_otg_low>;
		pinctrl-2 = <&gpio_otg_high>;
		pinctrl-3 = <&gpio_meta>;
		pinctrl-4 = <&gpio_meta_low>;
		pinctrl-5 = <&gpio_meta_high>;
		support_otg_dcp;
		otg_dcp_ctrl_type = <0x02>;
	};

	smart_charging {
		compatible = "tran,smart_charging";
		smartchg_min_cur = <0x7a120>;
		status = "okay";
	};

	water_detect: water_detect {
		status = "okay";
		compatible = "transsion, water_detect";
		bootmode = <&chosen>;
		polling_interval = <0x05>;
		scheme = <0x01>;
		gpio_x = <&pio 0x15 0x00>;
		gpio_y = <&pio 0x3e 0x00>;
	};
};

&pio {
	gpio_otg: otg_init {
		pins_cmd_dat {
			pinmux = <0x1a00>;
			slew-rate = <0x01>;
		};
	};

	gpio_otg_low: otg_low {
		pins_cmd_dat {
			pinmux = <0x1a00>;
			slew-rate = <0x01>;
			output-low;
		};
	};

	gpio_otg_high: otg_high {
		pins_cmd_dat {
			pinmux = <0x1a00>;
			slew-rate = <0x01>;
			output-high;
		};
	};

	gpio_meta: meta_init {
		pins_cmd_dat {
			pinmux = <0x1800>;
			slew-rate = <0x01>;
		};
	};

	gpio_meta_low: meta_low {
		pins_cmd_dat {
			pinmux = <0x1800>;
			slew-rate = <0x01>;
			output-low;
		};
	};

	gpio_meta_high: meta_high {
		pins_cmd_dat {
			pinmux = <0x1800>;
			slew-rate = <0x01>;
			output-high;
		};
	};
};

&pe2 {
	pe20_ichg_level_threshold = <0xf4240>;
	ta_start_battery_soc = <0x00>;
	ta_stop_battery_soc = <0x5a>;
	min_charger_voltage = <0x4630c0>;
	cable_imp_threshold = <0x2bb>;
	vbat_cable_imp_threshold = <0x3b8260>;
	sc_input_current = <0x1e8480>;
	sc_charger_current = <0x2dc6c0>;
	dcs_input_current = <0x30d400>;
	dcs_chg1_charger_current = <0x16e360>;
	dcs_chg2_charger_current = <0x16e360>;
	dual_polling_ieoc = <0x6ddd0>;
	slave_mivr_diff = <0x186a0>;
	vbat_threshold = <0x10fe>;
};

&tc30 {
	tc30_ichg_level_threshold = <0xf4240>;
	ta_start_battery_soc = <0x00>;
	ta_stop_battery_soc = <0x5a>;
	min_charger_voltage = <0x4630c0>;
	cable_imp_threshold = <0x2bb>;
	vbat_cable_imp_threshold = <0x3b8260>;
	sc_input_current = <0x1e8480>;
	sc_charger_current = <0x2dc6c0>;
	vbat_threshold = <0x1036>;
};

&hvdcp20 {
	hvdcp20_ichg_level_threshold = <0xf4240>;
	ta_start_battery_soc = <0x00>;
	ta_stop_battery_soc = <0x5a>;
	min_charger_voltage = <0x4630c0>;
	cable_imp_threshold = <0x2bb>;
	vbat_cable_imp_threshold = <0x3b8260>;
	sc_input_current = <0x1e8480>;
	sc_charger_current = <0x2dc6c0>;
	vbat_threshold = <0x1036>;
};

&pdc {
	pd_vbus_upper_bound = <0x895440>;
	min_charger_voltage = <0x4630c0>;
	sc_input_current = <0x2dc6c0>;
	sc_charger_current = <0x2dc6c0>;
	ibus_err = <0x0e>;
	vsys_watt = <0x4c4b40>;
};

&extcon_usb {
	compatible = "mediatek,extcon-usb";
	status = "okay";
	charger = <&switch_chg>;
	bootmode = <&chosen>;
};

&charger {
	compatible = "mediatek,charger";
	algorithm_name = "Basic";
	charger = <&switch_chg>;
	enable_sw_jeita;
	power_path_support;
	enable_ir_comp;
	r_bat_comp = <0x14>;
	v_comp_max = <0x7530>;
	charger_configuration = <0x03>;
	multi_battery_cv;
	battery_cv = <0x43e6d0 0x43e6d0 0x43e6d0 0x43e6d0>;
	max_charger_voltage = <0x632ea0>;
	min_charger_voltage = <0x4630c0>;
	min_charger_voltage_1 = <0x4630c0>;
	min_charger_voltage_2 = <0x432380>;
	max_dmivr_charger_current = <0x155cc0>;
	usb_charger_current_suspend = <0x00>;
	usb_charger_current_unconfigured = <0x11170>;
	usb_charger_current_configured = <0x7a120>;
	usb_charger_current = <0x7a120>;
	ac_charger_current = <0x2191c0>;
	ac_charger_input_current = <0x1e8480>;
	non_std_ac_charger_current = <0x124f80>;
	charging_host_charger_current = <0x16e360>;
	apple_1_0a_charger_current = <0x9eb10>;
	apple_2_1a_charger_current = "", "\f5";
	ta_ac_charger_current = <0x2dc6c0>;
	jeita_temp_above_t4_cv = <0x3f52f0 0x3f52f0 0x3f52f0 0x3f52f0>;
	jeita_temp_t3_to_t4_cv = <0x3f52f0 0x3f52f0 0x3f52f0 0x3f52f0>;
	jeita_temp_t2_to_t3_cv = <0x43e6d0 0x43e6d0 0x43e6d0 0x43e6d0>;
	jeita_temp_t1_to_t2_cv = <0x43e6d0 0x43e6d0 0x43e6d0 0x43e6d0>;
	jeita_temp_t0_to_t1_cv = <0x43e6d0 0x43e6d0 0x43e6d0 0x43e6d0>;
	jeita_temp_below_t0_cv = <0x43e6d0 0x43e6d0 0x43e6d0 0x43e6d0>;
	temp_t4_thres = <0x37>;
	temp_t4_thres_minus_x_degree = <0x33>;
	temp_t3_thres = <0x2d>;
	temp_t3_thres_minus_x_degree = <0x2c>;
	temp_t2_thres = <0x0f>;
	temp_t2_thres_plus_x_degree = <0x10>;
	temp_t1_thres = <0x01>;
	temp_t1_thres_plus_x_degree = <0x01>;
	temp_t0_thres = <0x01>;
	temp_t0_thres_plus_x_degree = <0x01>;
	temp_neg_10_thres = <0x02>;
	enable_min_charge_temp;
	min_charge_temp = <0x00>;
	min_charge_temp_plus_x_degree = <0x01>;
	max_charge_temp = <0x35>;
	max_charge_temp_minus_x_degree = <0x34>;
	ffc_battery_cv = "", "D\\";
	ffc_eoc = <0x9eb10>;
	non_ffc_eoc = <0x30d40>;
	dv2_ffc_gera_cv = <0x440de0 0x43bfc0 0x43bfc0>;
	dv2_ffc_gera_cycle = <0x12c 0x258 0x258>;
	battery_drop_cv_en;
};

&lk_charger {
	compatible = "mediatek,lk_charger";
	enable_anime;
	enable_pe_plus;
	enable_pd20_reset;
	power_path_support;
	max_charger_voltage = <0x632ea0>;
	fast_charge_voltage = <0x2625a0>;
	usb_charger_current = <0x7a120>;
	ac_charger_current = <0x16e360>;
	ac_charger_input_current = <0x16e360>;
	non_std_ac_charger_current = <0x7a120>;
	charging_host_charger_current = <0x16e360>;
	ta_ac_charger_current = <0x2dc6c0>;
	pd_charger_current = <0x7a120>;
	cur_threshold = <0x7a120>;
	temp_t4_threshold = <0x32>;
	temp_t3_threshold = <0x2d>;
	temp_t2_threshold = <0x0f>;
	temp_t1_threshold = <0x00>;
};

&odm {
	usb_control: usb_control {
		compatible = "transsion, usb_control";
		status = "okay";
		switch_control_type = <0x01>;
		rfc_control_type = <0x01>;
		ta_control_type = <0x00>;
		tc30_by_switch_ic_oneshot;
		pinctrl-names = "default", "hvdcp_handshake", "hvdcp_boost_5v", "hvdcp_boost_9v", "hvdcp_reset", "tc30_handshake", "tc30_reset", "rfc_i2c_mode", "rfc_dual_high", "rfc_high_low", "rfc_reset", "rfc_usb_switch_on", "rfc_usb_switch_off", "ta_off", "ta_reset";
		pinctrl-0 = <&default>;
		pinctrl-1 = <&hvdcp_handshake>;
		pinctrl-2 = <&hvdcp_boost_5v>;
		pinctrl-3 = <&hvdcp_boost_9v>;
		pinctrl-4 = <&hvdcp_reset>;
		pinctrl-5 = <&tc30_handshake>;
		pinctrl-6 = <&tc30_reset>;
		pinctrl-7 = <&rfc_i2c_mode>;
		pinctrl-8 = <&rfc_dual_high>;
		pinctrl-9 = <&rfc_high_low>;
		pinctrl-10 = <&rfc_reset>;
		pinctrl-11 = <&rfc_usb_switch_on>;
		pinctrl-12 = <&rfc_usb_switch_off>;
		pinctrl-13 = <&ta_off>;
		pinctrl-14 = <&ta_reset>;
	};
};

&pio {
	default: default {
	};

	hvdcp_handshake: hvdcp_handshake {
	};

	hvdcp_boost_5v: hvdcp_boost_5v {
	};

	hvdcp_boost_9v: hvdcp_boost_9v {
	};

	hvdcp_reset: hvdcp_reset {
	};

	tc30_handshake: tc30_handshake {
	};

	tc30_reset: tc30_reset {
	};

	rfc_i2c_mode: rfc_i2c_mode {
	};

	rfc_dual_high: rfc_dual_high {
	};

	rfc_high_low: rfc_high_low {
	};

	rfc_reset: rfc_reset {
	};

	rfc_usb_switch_on: usb_switch_on {
	};

	rfc_usb_switch_off: usb_switch_off {
	};

	ta_off: ta_off {
	};

	ta_reset: ta_reset {
	};
};

&auxadc {
	adc_channel@ {
		compatible = "mediatek,adc_channel";
		mediatek,adc_fdd_rf_params_dynamic_custom_ch = <0x02>;
		status = "okay";
	};
};

&gpio_usage_mapping {
	GPIO_SIM1_HOT_PLUG = <&pio 0x17 0x00>;
	GPIO_SIM1_SCLK = <&pio 0x4d 0x00>;
	GPIO_SIM1_SRST = <&pio 0x4e 0x00>;
	GPIO_SIM1_SIO = <&pio 0x4f 0x00>;
	GPIO_SIM2_SCLK = <&pio 0x50 0x00>;
	GPIO_SIM2_SRST = <&pio 0x51 0x00>;
	GPIO_SIM2_SIO = <&pio 0x52 0x00>;
};

&gpio {
	gpio_init_default = <0x00 0x00 0x00 0x00 0x01 0x01 0x01 0x01 0x00 0x00 0x00 0x01 0x00 0x01 0x02 0x00 0x00 0x00 0x01 0x00 0x01 0x03 0x00 0x00 0x00 0x01 0x00 0x01 0x04 0x00 0x00 0x00 0x01 0x01 0x01 0x05 0x00 0x00 0x00 0x00 0x00 0x01 0x06 0x00 0x01 0x00 0x01 0x00 0x01 0x07 0x00 0x00 0x00 0x01 0x01 0x01 0x08 0x00 0x00 0x00 0x01 0x01 0x01 0x09 0x00 0x00 0x00 0x01 0x01 0x01 0x0a 0x00 0x01 0x00 0x01 0x00 0x01 0x0b 0x00 0x00 0x00 0x01 0x01 0x01 0x0c 0x00 0x00 0x00 0x00 0x00 0x01 0x0d 0x00 0x00 0x00 0x01 0x00 0x01 0x0e 0x00 0x00 0x00 0x01 0x01 0x00 0x0f 0x00 0x01 0x00 0x01 0x00 0x00 0x10 0x00 0x01 0x00 0x01 0x00 0x00 0x11 0x00 0x00 0x00 0x01 0x00 0x00 0x12 0x00 0x01 0x00 0x01 0x00 0x00 0x13 0x00 0x01 0x00 0x01 0x00 0x00 0x14 0x00 0x01 0x00 0x01 0x00 0x00 0x15 0x00 0x01 0x00 0x01 0x00 0x00 0x16 0x00 0x01 0x00 0x01 0x00 0x00 0x17 0x01 0x00 0x00 0x01 0x01 0x00 0x18 0x00 0x01 0x00 0x01 0x00 0x00 0x19 0x00 0x01 0x00 0x01 0x00 0x01 0x1a 0x00 0x01 0x00 0x01 0x00 0x01 0x1b 0x01 0x01 0x00 0x01 0x00 0x01 0x1c 0x01 0x00 0x00 0x01 0x01 0x01 0x1d 0x01 0x00 0x00 0x00 0x00 0x01 0x1e 0x01 0x00 0x00 0x01 0x01 0x01 0x1f 0x01 0x00 0x00 0x01 0x01 0x01 0x20 0x01 0x00 0x00 0x01 0x00 0x01 0x21 0x01 0x00 0x00 0x01 0x00 0x01 0x22 0x01 0x00 0x00 0x01 0x01 0x00 0x23 0x00 0x00 0x00 0x01 0x01 0x00 0x24 0x01 0x00 0x00 0x01 0x00 0x00 0x25 0x01 0x00 0x00 0x01 0x00 0x00 0x26 0x02 0x00 0x00 0x00 0x00 0x01 0x27 0x02 0x00 0x00 0x00 0x00 0x01 0x28 0x02 0x00 0x00 0x00 0x00 0x01 0x29 0x02 0x00 0x00 0x01 0x00 0x01 0x2a 0x04 0x00 0x00 0x01 0x01 0x00 0x2b 0x00 0x01 0x00 0x01 0x00 0x00 0x2c 0x00 0x01 0x00 0x01 0x00 0x00 0x2d 0x00 0x00 0x00 0x00 0x00 0x00 0x2e 0x00 0x01 0x00 0x01 0x00 0x00 0x2f 0x00 0x01 0x00 0x01 0x00 0x00 0x30 0x00 0x01 0x00 0x01 0x00 0x00 0x31 0x06 0x00 0x00 0x01 0x00 0x00 0x32 0x02 0x00 0x00 0x00 0x00 0x01 0x33 0x00 0x01 0x00 0x01 0x00 0x01 0x34 0x02 0x00 0x00 0x00 0x00 0x01 0x35 0x00 0x00 0x00 0x00 0x00 0x01 0x36 0x00 0x01 0x00 0x01 0x00 0x00 0x37 0x00 0x01 0x00 0x01 0x00 0x00 0x38 0x00 0x01 0x00 0x01 0x00 0x00 0x39 0x00 0x00 0x00 0x01 0x00 0x00 0x3a 0x00 0x00 0x00 0x01 0x00 0x00 0x3b 0x00 0x00 0x00 0x01 0x00 0x00 0x3c 0x00 0x00 0x00 0x01 0x00 0x00 0x3d 0x00 0x00 0x00 0x01 0x00 0x00 0x3e 0x00 0x01 0x00 0x01 0x00 0x00 0x3f 0x00 0x00 0x00 0x01 0x00 0x00 0x40 0x00 0x01 0x00 0x01 0x00 0x01 0x41 0x00 0x01 0x00 0x01 0x00 0x00 0x42 0x01 0x00 0x00 0x01 0x01 0x00 0x43 0x01 0x00 0x00 0x01 0x01 0x00 0x44 0x05 0x00 0x00 0x01 0x00 0x01 0x45 0x00 0x00 0x00 0x01 0x01 0x01 0x47 0x01 0x00 0x00 0x01 0x00 0x01 0x48 0x01 0x00 0x00 0x01 0x00 0x01 0x49 0x01 0x00 0x00 0x01 0x00 0x01 0x4a 0x01 0x00 0x00 0x01 0x00 0x01 0x4b 0x01 0x00 0x00 0x01 0x00 0x01 0x4c 0x01 0x00 0x00 0x01 0x00 0x01 0x4d 0x01 0x00 0x00 0x00 0x00 0x01 0x4e 0x01 0x00 0x00 0x00 0x00 0x01 0x4f 0x01 0x00 0x00 0x01 0x01 0x01 0x50 0x01 0x00 0x00 0x00 0x00 0x01 0x51 0x01 0x00 0x00 0x00 0x00 0x01 0x52 0x01 0x00 0x00 0x01 0x01 0x01 0x53 0x01 0x00 0x00 0x01 0x00 0x01 0x54 0x01 0x00 0x00 0x00 0x00 0x01 0x55 0x00 0x01 0x00 0x01 0x00 0x01 0x56 0x01 0x00 0x00 0x01 0x00 0x00 0x57 0x01 0x00 0x00 0x01 0x00 0x00 0x58 0x01 0x00 0x00 0x01 0x00 0x00 0x59 0x01 0x00 0x00 0x01 0x00 0x00 0x5a 0x01 0x00 0x00 0x01 0x00 0x00 0x5b 0x01 0x00 0x00 0x01 0x00 0x00 0x5c 0x01 0x00 0x00 0x01 0x00 0x00 0x5d 0x01 0x00 0x00 0x01 0x00 0x00 0x5e 0x01 0x00 0x00 0x01 0x00 0x00 0x5f 0x01 0x00 0x00 0x01 0x00 0x00 0x60 0x01 0x00 0x00 0x01 0x00 0x00 0x61 0x01 0x00 0x00 0x01 0x00 0x00 0x62 0x01 0x00 0x00 0x01 0x00 0x00 0x63 0x01 0x00 0x00 0x01 0x00 0x00 0x64 0x01 0x00 0x00 0x01 0x00 0x00 0x65 0x01 0x00 0x00 0x01 0x00 0x00 0x66 0x01 0x00 0x00 0x01 0x00 0x00 0x67 0x01 0x00 0x00 0x01 0x00 0x01 0x68 0x01 0x00 0x00 0x01 0x00 0x00 0x69 0x01 0x00 0x00 0x01 0x00 0x00 0x6a 0x01 0x00 0x00 0x01 0x00 0x00 0x6b 0x01 0x00 0x00 0x01 0x00 0x00 0x6c 0x01 0x00 0x00 0x01 0x00 0x00 0x6d 0x01 0x00 0x00 0x01 0x00 0x00 0x6e 0x01 0x00 0x00 0x01 0x00 0x00 0x6f 0x01 0x00 0x00 0x01 0x00 0x00 0x70 0x01 0x00 0x00 0x01 0x00 0x00 0x71 0x01 0x00 0x00 0x01 0x00 0x00 0x72 0x01 0x00 0x00 0x01 0x00 0x00 0x73 0x01 0x00 0x00 0x01 0x00 0x00 0x74 0x01 0x00 0x00 0x00 0x00 0x00 0x75 0x01 0x00 0x00 0x01 0x00 0x00 0x76 0x01 0x00 0x00 0x00 0x00 0x00 0x77 0x01 0x00 0x00 0x01 0x00 0x00 0x78 0x01 0x00 0x00 0x00 0x00 0x00 0x79 0x01 0x00 0x00 0x01 0x00 0x00 0x7a 0x01 0x00 0x00 0x00 0x00 0x00 0x7b 0x01 0x00 0x00 0x00 0x00 0x00 0x7c 0x01 0x00 0x00 0x01 0x00 0x00 0x7d 0x01 0x00 0x00 0x01 0x00 0x00 0x7e 0x01 0x00 0x00 0x01 0x00 0x00 0x7f 0x01 0x00 0x00 0x01 0x00 0x00 0x80 0x01 0x00 0x00 0x01 0x00 0x00 0x81 0x01 0x00 0x00 0x01 0x00 0x00 0x82 0x01 0x00 0x00 0x01 0x01 0x01 0x83 0x01 0x00 0x00 0x01 0x01 0x01 0x84 0x02 0x00 0x00 0x01 0x01 0x00 0x85 0x02 0x00 0x00 0x01 0x01 0x00 0x86 0x01 0x00 0x00 0x01 0x01 0x01 0x87 0x01 0x00 0x00 0x01 0x01 0x01 0x88 0x01 0x00 0x00 0x01 0x01 0x01 0x89 0x01 0x00 0x00 0x01 0x01 0x01 0x8a 0x01 0x00 0x00 0x01 0x01 0x01 0x8b 0x01 0x00 0x00 0x01 0x01 0x01 0x8c 0x01 0x00 0x00 0x01 0x01 0x01 0x8d 0x01 0x00 0x00 0x01 0x01 0x01 0x8e 0x01 0x00 0x00 0x01 0x01 0x01 0x8f 0x01 0x00 0x00 0x01 0x01 0x01 0x90 0x01 0x00 0x00 0x01 0x01 0x01 0x91 0x01 0x00 0x00 0x01 0x01 0x01 0x92 0x01 0x00 0x00 0x01 0x01 0x01 0x93 0x01 0x00 0x00 0x01 0x01 0x01 0x94 0x01 0x00 0x00 0x01 0x01 0x01 0x95 0x01 0x00 0x00 0x01 0x01 0x01 0x96 0x00 0x01 0x00 0x01 0x00 0x01 0x97 0x00 0x01 0x01 0x01 0x00 0x01 0x98 0x00 0x01 0x00 0x01 0x00 0x01 0x99 0x00 0x01 0x00 0x01 0x00 0x01 0x9a 0x00 0x01 0x00 0x01 0x00 0x01 0x9b 0x00 0x01 0x00 0x01 0x00 0x01 0x9c 0x00 0x01 0x00 0x01 0x00 0x01 0x9d 0x00 0x01 0x00 0x01 0x00 0x01 0x9e 0x00 0x01 0x00 0x01 0x00 0x00 0x9f 0x00 0x01 0x00 0x01 0x00 0x00 0xa0 0x01 0x00 0x00 0x00 0x00 0x01 0xa1 0x01 0x00 0x00 0x00 0x00 0x01 0xa2 0x01 0x00 0x00 0x00 0x00 0x01 0xa3 0x01 0x00 0x00 0x01 0x00 0x01 0xa4 0x01 0x00 0x00 0x00 0x00 0x01 0xa5 0x01 0x00 0x00 0x00 0x00 0x01 0xa6 0x01 0x00 0x00 0x00 0x00 0x01 0xa7 0x01 0x00 0x00 0x01 0x00 0x01 0xa8 0x01 0x00 0x00 0x00 0x00 0x00 0xa9 0x01 0x00 0x00 0x00 0x00 0x01 0xaa 0x01 0x00 0x00 0x00 0x00 0x01 0xab 0x01 0x00 0x00 0x00 0x00 0x01 0xac 0x01 0x00 0x00 0x00 0x00 0x01 0xad 0x01 0x00 0x00 0x01 0x00 0x01 0xae 0x01 0x00 0x00 0x01 0x00 0x01 0xaf 0x01 0x00 0x00 0x01 0x00 0x01 0xb0 0x01 0x00 0x00 0x01 0x00 0x01 0xb1 0x00 0x00 0x00 0x01 0x00 0x00 0xb2 0x00 0x00 0x00 0x01 0x00 0x00 0xb3 0x00 0x00 0x00 0x01 0x00 0x00 0xb4 0x00 0x00 0x00 0x01 0x00 0x00 0xb5 0x00 0x00 0x00 0x01 0x00 0x00 0xb6 0x00 0x00 0x00 0x01 0x00 0x00 0xb7 0x00 0x00 0x00 0x01 0x00 0x00 0xb8 0x00 0x00 0x00 0x01 0x00 0x00 0xb9 0x00 0x00 0x00 0x01 0x00 0x00 0xba 0x01 0x00 0x00 0x01 0x01 0x01 0xbb 0x01 0x00 0x00 0x01 0x01 0x01 0xbc 0x00 0x00 0x00 0x01 0x00 0x00 0xbd 0x00 0x00 0x00 0x01 0x00 0x00 0xbe 0x00 0x00 0x00 0x01 0x00 0x00 0xbf 0x00 0x00 0x00 0x01 0x00 0x00 0xc0 0x00 0x00 0x00 0x01 0x00 0x00 0xc1 0x00 0x00 0x00 0x01 0x00 0x00 0xc2 0x00 0x00 0x00 0x01 0x00 0x00 0xc3 0x00 0x00 0x00 0x01 0x00 0x00 0xc4 0x00 0x00 0x00 0x01 0x00 0x00 0xc5 0x00 0x00 0x00 0x01 0x00 0x00 0xc6 0x00 0x00 0x00 0x01 0x00 0x00 0xc7 0x00 0x00 0x00 0x01 0x00 0x00 0xc8 0x00 0x00 0x00 0x01 0x00 0x00 0xc9 0x00 0x00 0x00 0x01 0x00 0x00 0xca 0x00 0x00 0x00 0x01 0x00 0x00 0xcb 0x00 0x00 0x00 0x01 0x00 0x00 0xcc 0x00 0x00 0x00 0x01 0x00 0x00 0xcd 0x00 0x00 0x00 0x01 0x00 0x00 0xce 0x00 0x00 0x00 0x01 0x00 0x00 0xcf 0x00 0x00 0x00 0x01 0x00 0x00 0xd0 0x00 0x00 0x00 0x01 0x00 0x00 0xd1 0x00 0x00 0x00 0x01 0x00 0x00 0xd2 0x00 0x00 0x00 0x01 0x00 0x00 0xd3 0x00 0x00 0x00 0x01 0x00 0x00 0xd4 0x00 0x00 0x00 0x01 0x00 0x00 0xd5 0x00 0x00 0x00 0x01 0x00 0x00 0xd6 0x00 0x00 0x00 0x01 0x00 0x00 0xd7 0x00 0x00 0x00 0x01 0x00 0x00 0xd8 0x00 0x00 0x00 0x01 0x00 0x00 0xd9 0x00 0x00 0x00 0x01 0x00 0x00 0xda 0x00 0x00 0x00 0x01 0x00 0x00 0xdb 0x00 0x00 0x00 0x01 0x00 0x00 0xdc 0x00 0x00 0x00 0x01 0x00 0x00 0xdd 0x00 0x00 0x00 0x01 0x00 0x00>;
};

&subpmic_pmu_eint {
	interrupt-parent = <&pio>;
	interrupts = <0x04 0x08>;
	status = "okay";
};

&rt5133_eint {
	interrupt-parent = <&pio>;
	interrupts = <0x05 0x02>;
	status = "okay";
};

&msdc1_ins {
	interrupt-parent = <&pio>;
	interrupts = <0x07 0x04>;
	deb-gpios = <&pio 0x07 0x00>;
	debounce = <0x186a0>;
	status = "okay";
};

&touch {
	interrupt-parent = <&pio>;
	interrupts = <0x09 0x02>;
	status = "okay";
};

&dsi_te {
	interrupt-parent = <&pio>;
	interrupts = <0x53 0x01>;
	status = "okay";
};

&md1_sim1_hot_plug_eint {
	compatible = "mediatek,md1_sim1_hot_plug_eint-eint";
	interrupts = <0x00 0x08>;
	debounce = <0x00 0x2710>;
	dedicated = <0x00 0x00>;
	src_pin = <0x00 0x01>;
	sockettype = <0x00 0x00>;
	status = "okay";
};

&keypad {
	mediatek,key-debounce = <0x400>;
	mediatek,sw-pwrkey = <0x74>;
	mediatek,hw-pwrkey = <0x08>;
	mediatek,use-extend-type = <0x00>;
	mediatek,hw-map-num = <0x48>;
	mediatek,hw-init-map = <0x73 0x72 0x00 0x00 0x00 0x00 0x00 0x00 0x00 0x00 0x00 0x00 0x00 0x00 0x00 0x00 0x00 0x00 0x00 0x00 0x00 0x00 0x00 0x00 0x00 0x00 0x00 0x00 0x00 0x00 0x00 0x00 0x00 0x00 0x00 0x00 0x00 0x00 0x00 0x00 0x00 0x00 0x00 0x00 0x00 0x00 0x00 0x00 0x00 0x00 0x00 0x00 0x00 0x00 0x00 0x00 0x00 0x00 0x00 0x00 0x00 0x00 0x00 0x00 0x00 0x00 0x00 0x00 0x00 0x00 0x00 0x00>;
	mediatek,pwrkey-eint-gpio = <0x00>;
	mediatek,pwkey-gpio-din = <0x00>;
	mediatek,hw-dl-key0 = <0x00>;
	mediatek,hw-dl-key1 = <0x01>;
	mediatek,hw-dl-key2 = <0x08>;
	mediatek,hw-recovery-key = <0x00>;
	mediatek,hw-factory-key = <0x01>;
	status = "okay";
};
